## conf/layer.conf
```bitbake
# We have a conf and classes directory, add to BBPATH
BBPATH .= ":${LAYERDIR}"

# We have recipes-* directories, add to BBFILES
BBFILES += "${LAYERDIR}/recipes-*/*/*.bb \
            ${LAYERDIR}/recipes-*/*/*.bbappend"

BBFILE_COLLECTIONS += "meta-fec"
BBFILE_PATTERN_meta-fec = "^${LAYERDIR}/"
BBFILE_PRIORITY_meta-fec = "6"

LAYERDEPENDS_meta-fec = "core"
LAYERSERIES_COMPAT_meta-fec = "mickledore"
```
